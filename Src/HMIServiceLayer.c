/*
 * HMIServiceLayer.c
 *
 *  Created on: 15 dic. 2019
 *      Author: Gerardo
 */
#include <SPIDriver.h>
#include "HMIServiceLayer.h"
#include "stm32l4xx_hal.h"


const unsigned char FONT_6x8[97][8] = {
0x06,0x08,0x08,0x00,0x00,0x00,0x00,0x00, // columns, rows, num_bytes_per_char
0x00,0x00,0x00,0x00,0x00,0x00,0x00,0x00, // space 0x20
0x20,0x20,0x20,0x20,0x20,0x00,0x20,0x00, // !
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0x70,0xD8,0xD8,0x70,0x00,0x00,0x00,0x00}; // DEL

const unsigned char FONT_8x8[97][8] = {
0x08,0x08,0x08,0x00,0x00,0x00,0x00,0x00, // columns, rows, num_bytes_per_char
0x00,0x00,0x00,0x00,0x00,0x00,0x00,0x00, // space 0x20
0x30,0x78,0x78,0x30,0x30,0x00,0x30,0x00, // !
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0x1C,0x36,0x36,0x1C,0x00,0x00,0x00,0x00}; // DEL

const unsigned char FONT_8x16[97][16] = {
0x08,0x10,0x10,0x00,0x00,0x00,0x00,0x00,0x00,0x00,0x00,0x00,0x00,0x00,0x00,0x00, // columns, rows, nbytes
0x00,0x00,0x00,0x00,0x00,0x00,0x00,0x00,0x00,0x00,0x00,0x00,0x00,0x00,0x00,0x00, // space 0x20
0x00,0x00,0x18,0x3C,0x3C,0x3C,0x18,0x18,0x18,0x00,0x18,0x18,0x00,0x00,0x00,0x00, // !
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0x00,0x70,0xD8,0xD8,0x70,0x00,0x00,0x00,0x00,0x00,0x00,0x00,0x00,0x00,0x00,0x00}; // DEL



void ServiceLayerInitLcd(void) {
	// Hardware reset

	// Sleep out (command 0x11)
	DriverWriteSPIcommand(SLEEPOUT);

	// Inversion on (command 0x20)
	//WriteSpiCommand(INVON); // seems to be required for this controller
	DriverWriteSPIcommand(INVOFF);

	// Color Interface Pixel Format (command 0x3A)
	DriverWriteSPIcommand(COLMOD);
	DriverWriteSPIdata(0x03); // 0x03 = 12 bits-per-pixel

	// Memory access controler (command 0x36)
	DriverWriteSPIcommand(MADCTL);
	//WriteSpiData(0xC8); // 0xC0 = mirror x and y, reverse rgb
	DriverWriteSPIdata(0x80);

	// Write contrast (command 0x25)
	DriverWriteSPIcommand(SETCON);
	DriverWriteSPIdata(0x30); // contrast 0x30
	HAL_Delay(1000);
	// Display On (command 0x29)
	DriverWriteSPIcommand(DISPON);
}

void LCDPutStr(char *pString, int x, int y, int Size, int fColor, int bColor) {
	// loop until null-terminator is seen
	while (*pString != 0x00)
	{
		// draw the character
		LCDPutChar(*pString++, x, y, Size, fColor, bColor);
		// advance the y position
		if (Size == SMALL)
			y = y + 6;
		else if (Size == MEDIUM)
			y = y + 8;
		else
			y = y + 8;
		// bail out if y exceeds 131
		if (y > 131) break;
	}
}

void LCDPutChar(char c, int x, int y, int size, int fColor, int bColor) {
	int i,j;
	unsigned int nCols;
	unsigned int nRows;
	unsigned int nBytes;
	unsigned char PixelRow;
	unsigned char Mask;
	unsigned int Word0;
	unsigned int Word1;
	unsigned char *pFont;
	unsigned char *pChar;
	unsigned char *FontTable[] = {(unsigned char *)FONT_6x8,
			(unsigned char *)FONT_8x8,
			(unsigned char *)FONT_8x16};
	// get pointer to the beginning of the selected font table
	pFont = (unsigned char *)FontTable[size];
	// get the nColumns, nRows and nBytes
	nCols = *pFont;
	nRows = *(pFont + 1);
	nBytes = *(pFont + 2);
	// get pointer to the last byte of the desired character
	pChar = pFont + (nBytes * (c - 0x1F)) + nBytes - 1;
	// Row address set (command 0x2B)
	DriverWriteSPIcommand(PASET);
	DriverWriteSPIdata(x);
	DriverWriteSPIdata(x + nRows - 1);
	// Column address set (command 0x2A)
	DriverWriteSPIcommand(CASET);
	DriverWriteSPIdata(y);
	DriverWriteSPIdata(y + nCols - 1);
	// WRITE MEMORY
	DriverWriteSPIcommand(RAMWR);
	// loop on each row, working backwards from the bottom to the top
	for (i = nRows - 1; i >= 0; i--) {
		// copy pixel row from font table and then decrement row
		PixelRow = *pChar--;
		// loop on each pixel in the row (left to right)
		// Note: we do two pixels each loop
		Mask = 0x80;
		for (j = 0; j < nCols; j += 2) {
			// if pixel bit set, use foreground color; else use the background color
			// now get the pixel color for two successive pixels
			if ((PixelRow & Mask) == 0)
				Word0 = bColor;
			else
				Word0 = fColor;
			Mask = Mask >> 1;
			if ((PixelRow & Mask) == 0)
				Word1 = bColor;
			else
				Word1 = fColor;
			Mask = Mask >> 1;
			// use this information to output three data bytes
			DriverWriteSPIdata((Word0 >> 4) & 0xFF);
			DriverWriteSPIdata(((Word0 & 0xF) << 4) | ((Word1 >> 8) & 0xF));
			DriverWriteSPIdata(Word1 & 0xFF);
		}
	}
	// terminate the Write Memory command
	DriverWriteSPIcommand(NOP);
}

_Bool ServiceLayerButtonHasBeenPressed(){
	_Bool state = 0;

	return state;
}

_Bool ServiceLayerUpPressed(){
	_Bool state = 0;

	return state;
}

_Bool ServiceLayerDownPressed(){
	_Bool state = 0;

	return state;
}

_Bool ServiceLayerValidatePressed(){
	_Bool state = 0;

	return state;
}

_Bool ServiceLayerBackPressed(){
	_Bool state = 0;

	return state;
}

void ServiceLayerUpdateCursorPosition(HMImenus cursorPosition){

}

_Bool ServiceLayerAlertHasOccurred(){
	_Bool state = 0;

	return state;
}

void ServiceLayerPrintInformativeMenu(){

}

void ServiceLayerPrintInteractiveMenuSelector(){

}

void ServiceLayerPrintBatteryMenu(){

}

void ServiceLayerPrintDateMenu(){

}

void ServiceLayerPrintBuckMenu(){

}

void ServiceLayerPrintAlertMenu(){

}

